# M2Sxxx register map
Vendor: Microsemi; Series: SmartFusion2; File version: 2.0.32
CPU: CM3 r2p1, little endian, MPU, no FPU, 4 interrupt priority bits
Registers are 32-bit, read-write, no defined reset value unless marked. A register's access mark holds for its fields unless they carry their own. Offsets are from the block's base; [hi:lo] are bit positions; {n}, {i} and the like mark numbered series.

## SERDES_1_PCIE — No description provided for this peripheral
Base 0x4002C000
0x00 SERDES1_PCIE_VID_DEVID — No description provided for this register
  [31:0] value — No description provided for this field
0x04 SERDES1_PCIE_CFG_PRMSCR — No description provided for this register
  [31:0] value — No description provided for this field
0x08 SERDES1_PCIE_CLASS_CODE — No description provided for this register
  [31:0] value — No description provided for this field
{0x10+4i} SERDES1_PCIE_BAR{i} (i=0..5) — No description provided for this register
  [31:0] value — No description provided for this field
0x2C SERDES1_PCIE_SUBSYSTEM_ID — No description provided for this register
  [31:0] value — No description provided for this field
0x30 SERDES1_PCIE_SERDES1_PCIE_DEVSCR — No description provided for this register
  [31:0] value — No description provided for this field
0x34 SERDES1_PCIE_SERDES1_PCIE_LINKSCR — No description provided for this register
  [31:0] value — No description provided for this field
0x38 SERDES1_PCIE_TC_VC_MAPPING — No description provided for this register
  [31:0] value — No description provided for this field
0x3C SERDES1_PCIE_CAPTURED_BUS_DEVICE_NB — No description provided for this register
  [31:0] value — No description provided for this field
0x40 SERDES1_PCIE_MSI_CTRL_STATUS — No description provided for this register
  [31:0] value — No description provided for this field
0x44 SERDES1_PCIE_LTSSM — No description provided for this register
  [31:0] value — No description provided for this field
0x48 SERDES1_PCIE_POWER_MGT_CAPABILITY — No description provided for this register
  [31:0] value — No description provided for this field
0x4C SERDES1_PCIE_CFG_PMSCR — No description provided for this register
  [31:0] value — No description provided for this field
0x50 SERDES1_PCIE_AER_ECRC_CAPABILITY — No description provided for this register
  [31:0] value — No description provided for this field
0x54 SERDES1_PCIE_VC1_CAPABILITY — No description provided for this register
  [31:0] value — No description provided for this field
0x58 SERDES1_PCIE_MAX_PAYLOAD_SIZE — No description provided for this register
  [31:0] value — No description provided for this field
0x5C SERDES1_PCIE_CLKREQ — No description provided for this register
  [31:0] value — No description provided for this field
0x60 SERDES1_PCIE_ASPM_L0S_CAPABILITY — No description provided for this register
  [31:0] value — No description provided for this field
0x64 SERDES1_PCIE_ASPM_L1_CAPABILITY — No description provided for this register
  [31:0] value — No description provided for this field
0x68 SERDES1_PCIE_TIMEOUT_COMPLETION — No description provided for this register
  [31:0] value — No description provided for this field
{0x70+4i} SERDES1_PCIE_PM_DATA_SCALE{i} (i=0..3) — No description provided for this register
  [31:0] value — No description provided for this field
{0x80+4i} SERDES1_PCIE_MSI{i} (i=0..7) — No description provided for this register
  [31:0] value — No description provided for this field
{0xA0+4i} SERDES1_PCIE_ERROR_COUNTER{i} (i=0..3) — No description provided for this register
  [31:0] value — No description provided for this field
{0xB0+4i} SERDES1_PCIE_CREDIT_ALLOCATION{i} (i=0..3) — No description provided for this register
  [31:0] value — No description provided for this field
{0xC0+0x10*i} SERDES1_PCIE_AXI_SLAVE_WINDOW_{i}_BASE (i=0..3) — No description provided for this register
  [31:0] value — No description provided for this field
{0xC4+0x10*i} SERDES1_PCIE_AXI_SLAVE_WINDOW_{i}_SIZE (i=0..3) — No description provided for this register
  [31:0] value — No description provided for this field
{0xC8+0x10*i} SERDES1_PCIE_AXI_SLAVE_WINDOW_{i}_LSB (i=0..3) — No description provided for this register
  [31:0] value — No description provided for this field
{0xCC+0x10*i} SERDES1_PCIE_AXI_SLAVE_WINDOW_{i}_MSB (i=0..3) — No description provided for this register
  [31:0] value — No description provided for this field
{0x100+0x10*i} SERDES1_PCIE_AXI_MASTER_WINDOW_{i}_BASE (i=0..3) — No description provided for this register
  [31:0] value — No description provided for this field
{0x104+0x10*i} SERDES1_PCIE_AXI_MASTER_WINDOW_{i}_SIZE (i=0..3) — No description provided for this register
  [31:0] value — No description provided for this field
{0x108+0x10*i} SERDES1_PCIE_AXI_MASTER_WINDOW_{i}_LSB (i=0..3) — No description provided for this register
  [31:0] value — No description provided for this field
{0x10C+0x10*i} SERDES1_PCIE_AXI_MASTER_WINDOW_{i}_MSB (i=0..3) — No description provided for this register
  [31:0] value — No description provided for this field
0x140 SERDES1_PCIE_IMASK — No description provided for this register
  [31:0] value — No description provided for this field
0x144 SERDES1_PCIE_ISTATUS — No description provided for this register
  [31:0] value — No description provided for this field
0x148 SERDES1_PCIE_ICMD — No description provided for this register
  [31:0] value — No description provided for this field
0x14C SERDES1_PCIE_IRSTATUS — No description provided for this register
  [31:0] value — No description provided for this field
0x150 SERDES1_PCIE_IMSIADDR — No description provided for this register
  [31:0] value — No description provided for this field
0x154 SERDES1_PCIE_SLOTCAP — No description provided for this register
  [31:0] value — No description provided for this field
0x158 SERDES1_PCIE_SLOTCSR — No description provided for this register
  [31:0] value — No description provided for this field
0x15C SERDES1_PCIE_ROOTCSR — No description provided for this register
  [31:0] value — No description provided for this field
0x160 SERDES1_PCIE_CFG_CONTROL — No description provided for this register
  [31:0] value — No description provided for this field
0x164 SERDES1_PCIE_CFG_WRITE_DATA — No description provided for this register
  [31:0] value — No description provided for this field
0x168 SERDES1_PCIE_CFG_READ_DATA — No description provided for this register
  [31:0] value — No description provided for this field
0x16C SERDES1_PCIE_INFO — No description provided for this register
  [31:0] value — No description provided for this field
0x170 SERDES1_PCIE_IO_CONTROL — No description provided for this register
  [31:0] value — No description provided for this field
0x174 SERDES1_PCIE_IO_ADDR — No description provided for this register
  [31:0] value — No description provided for this field
0x178 SERDES1_PCIE_IO_WRITE_DATA — No description provided for this register
  [31:0] value — No description provided for this field
0x17C SERDES1_PCIE_IO_READ_DATA — No description provided for this register
  [31:0] value — No description provided for this field
0x180 SERDES1_PCIE_CFG_FBE — No description provided for this register
  [31:0] value — No description provided for this field
0x184 SERDES1_PCIE_PREFETCH_IO_WINDOW — No description provided for this register
  [31:0] value — No description provided for this field
0x204 SERDES1_PCIE_CONFIG — No description provided for this register
  [31:0] value — No description provided for this field
0x230 SERDES1_PCIE_SERDES1_PCIE_DEV2SCR — No description provided for this register
  [31:0] value — No description provided for this field
0x234 SERDES1_PCIE_SERDES1_PCIE_LINK2SCR — No description provided for this register
  [31:0] value — No description provided for this field
0x260 SERDES1_PCIE_ASPM_L0S_GEN2 — No description provided for this register
  [31:0] value — No description provided for this field
{0x300+4i} SERDES1_PCIE_K_CNT_CONFIG{i} (i=0..5) — No description provided for this register
  [31:0] value — No description provided for this field
