# M2Sxxx register map
Vendor: Microsemi; Series: SmartFusion2; File version: 2.0.32
CPU: CM3 r2p1, little endian, MPU, no FPU, 4 interrupt priority bits
Registers are 32-bit, read-write, no defined reset value unless marked. A register's access mark holds for its fields unless they carry their own. Offsets are from the block's base; [hi:lo] are bit positions; {n}, {i} and the like mark numbered series.

## SERDES_0_LANE_3 — No description provided for this peripheral
Base 0x40029C00
0x00 SERDES0_LANE3_CR0 — No description provided for this register
  [31:0] value — No description provided for this field
0x04 SERDES0_LANE3_ERRCNT_DEC — No description provided for this register
  [31:0] value — No description provided for this field
0x08 SERDES0_LANE3_RXIDLE_MAX_ERRCNT_DEC — No description provided for this register
  [31:0] value — No description provided for this field
0x0C SERDES0_LANE3_IMPED_RATIO — No description provided for this register
  [31:0] value — No description provided for this field
0x10 SERDES0_LANE3_PLL_F_PCLK_RATIO — No description provided for this register
  [31:0] value — No description provided for this field
0x14 SERDES0_LANE3_PLL_M_N — No description provided for this register
  [31:0] value — No description provided for this field
0x18 SERDES0_LANE3_CNT250NS_MAX — No description provided for this register
  [31:0] value — No description provided for this field
0x1C SERDES0_LANE3_RE_AMP_RATIO — No description provided for this register
  [31:0] value — No description provided for this field
0x20 SERDES0_LANE3_RE_CUT_RATIO — No description provided for this register
  [31:0] value — No description provided for this field
0x24 SERDES0_LANE3_TX_AMP_RATIO — No description provided for this register
  [31:0] value — No description provided for this field
0x28 SERDES0_LANE3_TX_PST_RATIO — No description provided for this register
  [31:0] value — No description provided for this field
0x2C SERDES0_LANE3_TX_PRE_RATIO — No description provided for this register
  [31:0] value — No description provided for this field
0x30 SERDES0_LANE3_ENDCALIB_MAX — No description provided for this register
  [31:0] value — No description provided for this field
0x34 SERDES0_LANE3_CALIB_STABILITY_COUNT — No description provided for this register
  [31:0] value — No description provided for this field
0x38 SERDES0_LANE3_POWER_DOWN — No description provided for this register
  [31:0] value — No description provided for this field
0x3C SERDES0_LANE3_RX_OFFSET_COUNT — No description provided for this register
  [31:0] value — No description provided for this field
0x40 SERDES0_LANE3_PLL_F_PCLK_RATIO_5GBPS — No description provided for this register
  [31:0] value — No description provided for this field
0x44 SERDES0_LANE3_PLL_M_N_5GBPS — No description provided for this register
  [31:0] value — No description provided for this field
0x48 SERDES0_LANE3_CNT250NS_MAX_5GBPS — No description provided for this register
  [31:0] value — No description provided for this field
0x50 SERDES0_LANE3_TX_PST_RATIO_DEEMP0_FULL — No description provided for this register
  [31:0] value — No description provided for this field
0x54 SERDES0_LANE3_TX_PRE_RATIO_DEEMP0_FULL — No description provided for this register
  [31:0] value — No description provided for this field
0x58 SERDES0_LANE3_TX_PST_RATIO_DEEMP1_FULL — No description provided for this register
  [31:0] value — No description provided for this field
0x5C SERDES0_LANE3_TX_PRE_RATIO_DEEMP1_FULL — No description provided for this register
  [31:0] value — No description provided for this field
{0x60+4i} SERDES0_LANE3_TX_AMP_RATIO_MARGIN{i}_FULL (i=0..7) — No description provided for this register
  [31:0] value — No description provided for this field
0x80 SERDES0_LANE3_RE_AMP_RATIO_DEEMP0 — No description provided for this register
  [31:0] value — No description provided for this field
0x84 SERDES0_LANE3_RE_CUT_RATIO_DEEMP0 — No description provided for this register
  [31:0] value — No description provided for this field
0x88 SERDES0_LANE3_RE_AMP_RATIO_DEEMP1 — No description provided for this register
  [31:0] value — No description provided for this field
0x8C SERDES0_LANE3_RE_CUT_RATIO_DEEMP1 — No description provided for this register
  [31:0] value — No description provided for this field
0x90 SERDES0_LANE3_TX_PST_RATIO_DEEMP0_HALF — No description provided for this register
  [31:0] value — No description provided for this field
0x94 SERDES0_LANE3_TX_PRE_RATIO_DEEMP0_HALF — No description provided for this register
  [31:0] value — No description provided for this field
0x98 SERDES0_LANE3_TX_PST_RATIO_DEEMP1_HALF — No description provided for this register
  [31:0] value — No description provided for this field
0x9C SERDES0_LANE3_TX_PRE_RATIO_DEEMP1_HALF — No description provided for this register
  [31:0] value — No description provided for this field
{0xA0+4i} SERDES0_LANE3_TX_AMP_RATIO_MARGIN{i}_HALF (i=0..7) — No description provided for this register
  [31:0] value — No description provided for this field
0xC0 SERDES0_LANE3_PMA_STATUS — No description provided for this register
  [31:0] value — No description provided for this field
0xC4 SERDES0_LANE3_TX_SWEEP_CENTER — No description provided for this register
  [31:0] value — No description provided for this field
0xC8 SERDES0_LANE3_RX_SWEEP_CENTER — No description provided for this register
  [31:0] value — No description provided for this field
0xCC SERDES0_LANE3_RE_SWEEP_CENTER — No description provided for this register
  [31:0] value — No description provided for this field
0xD0 SERDES0_LANE3_ATXDRR_7_0 — No description provided for this register
  [31:0] value — No description provided for this field
0xD4 SERDES0_LANE3_ATXDRR_14_8 — No description provided for this register
  [31:0] value — No description provided for this field
0xD8 SERDES0_LANE3_ATXDRP_DYN_7_0 — No description provided for this register
  [31:0] value — No description provided for this field
0xDC SERDES0_LANE3_ATXDRP_DYN_15_8 — No description provided for this register
  [31:0] value — No description provided for this field
0xE0 SERDES0_LANE3_ATXDRP_DYN_20_16 — No description provided for this register
  [31:0] value — No description provided for this field
0xE4 SERDES0_LANE3_ATXDRA_DYN_7_0 — No description provided for this register
  [31:0] value — No description provided for this field
0xE8 SERDES0_LANE3_ATXDRA_DYN_15_8 — No description provided for this register
  [31:0] value — No description provided for this field
0xEC SERDES0_LANE3_ATXDRA_DYN_20_16 — No description provided for this register
  [31:0] value — No description provided for this field
0xF0 SERDES0_LANE3_ATXDRT_DYN_7_0 — No description provided for this register
  [31:0] value — No description provided for this field
0xF4 SERDES0_LANE3_ATXDRT_DYN_15_8 — No description provided for this register
  [31:0] value — No description provided for this field
0xF8 SERDES0_LANE3_ATXDRT_DYN_20_16 — No description provided for this register
  [31:0] value — No description provided for this field
0xFC SERDES0_LANE3_ATXDRP_EI1_7_0 — No description provided for this register
  [31:0] value — No description provided for this field
0x100 SERDES0_LANE3_ATXDRP_EI1_15_8 — No description provided for this register
  [31:0] value — No description provided for this field
0x104 SERDES0_LANE3_ATXDRP_EI1_20_16 — No description provided for this register
  [31:0] value — No description provided for this field
0x108 SERDES0_LANE3_ATXDRA_EI1_7_0 — No description provided for this register
  [31:0] value — No description provided for this field
0x10C SERDES0_LANE3_ATXDRA_EI1_15_8 — No description provided for this register
  [31:0] value — No description provided for this field
0x110 SERDES0_LANE3_ATXDRA_EI1_20_16 — No description provided for this register
  [31:0] value — No description provided for this field
0x114 SERDES0_LANE3_ATXDRT_EI1_7_0 — No description provided for this register
  [31:0] value — No description provided for this field
0x118 SERDES0_LANE3_ATXDRT_EI1_15_8 — No description provided for this register
  [31:0] value — No description provided for this field
0x11C SERDES0_LANE3_ATXDRT_EI1_20_16 — No description provided for this register
  [31:0] value — No description provided for this field
0x120 SERDES0_LANE3_ATXDRP_EI2_7_0 — No description provided for this register
  [31:0] value — No description provided for this field
0x124 SERDES0_LANE3_ATXDRP_EI2_15_8 — No description provided for this register
  [31:0] value — No description provided for this field
0x128 SERDES0_LANE3_ATXDRP_EI2_20_16 — No description provided for this register
  [31:0] value — No description provided for this field
0x12C SERDES0_LANE3_ATXDRA_EI2_7_0 — No description provided for this register
  [31:0] value — No description provided for this field
0x130 SERDES0_LANE3_ATXDRA_EI2_15_8 — No description provided for this register
  [31:0] value — No description provided for this field
0x134 SERDES0_LANE3_ATXDRA_EI2_20_16 — No description provided for this register
  [31:0] value — No description provided for this field
0x138 SERDES0_LANE3_ATXDRT_EI2_7_0 — No description provided for this register
  [31:0] value — No description provided for this field
0x13C SERDES0_LANE3_ATXDRT_EI2_15_8 — No description provided for this register
  [31:0] value — No description provided for this field
0x140 SERDES0_LANE3_ATXDRT_EI2_20_16 — No description provided for this register
  [31:0] value — No description provided for this field
0x144 SERDES0_LANE3_OVERRIDE_CALIB — No description provided for this register
  [31:0] value — No description provided for this field
0x148 SERDES0_LANE3_FORCE_ATXDRR_7_0 — No description provided for this register
  [31:0] value — No description provided for this field
0x14C SERDES0_LANE3_FORCE_ATXDRR_15_8 — No description provided for this register
  [31:0] value — No description provided for this field
0x150 SERDES0_LANE3_FORCE_ATXDRR_20_16 — No description provided for this register
  [31:0] value — No description provided for this field
0x154 SERDES0_LANE3_FORCE_ATXDRP_7_0 — No description provided for this register
  [31:0] value — No description provided for this field
0x158 SERDES0_LANE3_FORCE_ATXDRP_15_8 — No description provided for this register
  [31:0] value — No description provided for this field
0x15C SERDES0_LANE3_FORCE_ATXDRP_20_16 — No description provided for this register
  [31:0] value — No description provided for this field
0x160 SERDES0_LANE3_FORCE_ATXDRA_7_0 — No description provided for this register
  [31:0] value — No description provided for this field
0x164 SERDES0_LANE3_FORCE_ATXDRA_15_8 — No description provided for this register
  [31:0] value — No description provided for this field
0x168 SERDES0_LANE3_FORCE_ATXDRA_20_16 — No description provided for this register
  [31:0] value — No description provided for this field
0x16C SERDES0_LANE3_FORCE_ATXDRT_7_0 — No description provided for this register
  [31:0] value — No description provided for this field
0x170 SERDES0_LANE3_FORCE_ATXDRT_15_8 — No description provided for this register
  [31:0] value — No description provided for this field
0x174 SERDES0_LANE3_FORCE_ATXDRT_20_16 — No description provided for this register
  [31:0] value — No description provided for this field
0x178 SERDES0_LANE3_RXD_OFFSET_CALIB_RESULT — No description provided for this register
  [31:0] value — No description provided for this field
0x17C SERDES0_LANE3_RXT_OFFSET_CALIB_RESULT — No description provided for this register
  [31:0] value — No description provided for this field
0x180 SERDES0_LANE3_SCHMITT_TRIG_CALIB_RESULT — No description provided for this register
  [31:0] value — No description provided for this field
0x184 SERDES0_LANE3_FORCE_RXD_OFFSET_CALIB — No description provided for this register
  [31:0] value — No description provided for this field
0x188 SERDES0_LANE3_FORCE_RXT_OFFSET_CALIB — No description provided for this register
  [31:0] value — No description provided for this field
0x18C SERDES0_LANE3_FORCE_SCHMITT_TRIG_CALIB — No description provided for this register
  [31:0] value — No description provided for this field
0x190 SERDES0_LANE3_PRBS_CTRL — No description provided for this register
  [31:0] value — No description provided for this field
0x194 SERDES0_LANE3_PRBS_ERRCNT — No description provided for this register
  [31:0] value — No description provided for this field
0x198 SERDES0_LANE3_PHY_RESET_OVERRIDE — No description provided for this register
  [31:0] value — No description provided for this field
0x19C SERDES0_LANE3_PHY_POWER_OVERRIDE — No description provided for this register
  [31:0] value — No description provided for this field
0x1A0 SERDES0_LANE3_CUSTOM_PATTERN_7_0 — No description provided for this register
  [31:0] value — No description provided for this field
0x1A4 SERDES0_LANE3_CUSTOM_PATTERN_15_8 — No description provided for this register
  [31:0] value — No description provided for this field
0x1A8 SERDES0_LANE3_CUSTOM_PATTERN_23_16 — No description provided for this register
  [31:0] value — No description provided for this field
0x1AC SERDES0_LANE3_CUSTOM_PATTERN_31_24 — No description provided for this register
  [31:0] value — No description provided for this field
0x1B0 SERDES0_LANE3_CUSTOM_PATTERN_39_32 — No description provided for this register
  [31:0] value — No description provided for this field
0x1B4 SERDES0_LANE3_CUSTOM_PATTERN_47_40 — No description provided for this register
  [31:0] value — No description provided for this field
0x1B8 SERDES0_LANE3_CUSTOM_PATTERN55_48 — No description provided for this register
  [31:0] value — No description provided for this field
0x1BC SERDES0_LANE3_CUSTOM_PATTERN_63_56 — No description provided for this register
  [31:0] value — No description provided for this field
0x1C0 SERDES0_LANE3_CUSTOM_PATTERN_71_64 — No description provided for this register
  [31:0] value — No description provided for this field
0x1C4 SERDES0_LANE3_CUSTOM_PATTERN_79_72 — No description provided for this register
  [31:0] value — No description provided for this field
0x1C8 SERDES0_LANE3_CUSTOM_PATTERN_CTRL — No description provided for this register
  [31:0] value — No description provided for this field
0x1CC SERDES0_LANE3_CUSTOM_PATTERN_STATUS — No description provided for this register
  [31:0] value — No description provided for this field
0x1D0 SERDES0_LANE3_PCS_LOOPBBACK_CTRL — No description provided for this register
  [31:0] value — No description provided for this field
0x1D4 SERDES0_LANE3_GEN1_TX_PLL_CCP — No description provided for this register
  [31:0] value — No description provided for this field
0x1D8 SERDES0_LANE3_GEN1_RX_PLL_CCP — No description provided for this register
  [31:0] value — No description provided for this field
0x1DC SERDES0_LANE3_GEN2_TX_PLL_CCP — No description provided for this register
  [31:0] value — No description provided for this field
0x1E0 SERDES0_LANE3_GEN2_RX_PLL_CCP — No description provided for this register
  [31:0] value — No description provided for this field
0x1E4 SERDES0_LANE3_CDR_PLL_MANUAL_CR — No description provided for this register
  [31:0] value — No description provided for this field
0x200 SERDES0_LANE3_UPDATE_SETTINGS — No description provided for this register
  [31:0] value — No description provided for this field
0x280 SERDES0_LANE3_PRBS_ERR_CYC_FIRST_7_0 — No description provided for this register
  [31:0] value — No description provided for this field
0x284 SERDES0_LANE3_PRBS_ERR_CYC_FIRST_15_8 — No description provided for this register
  [31:0] value — No description provided for this field
0x288 SERDES0_LANE3_PRBS_ERR_CYC_FIRST_23_16 — No description provided for this register
  [31:0] value — No description provided for this field
0x28C SERDES0_LANE3_PRBS_ERR_CYC_FIRST_31_24 — No description provided for this register
  [31:0] value — No description provided for this field
0x290 SERDES0_LANE3_PRBS_ERR_CYC_FIRST_39_32 — No description provided for this register
  [31:0] value — No description provided for this field
0x294 SERDES0_LANE3_PRBS_ERR_CYC_FIRST_47_40 — No description provided for this register
  [31:0] value — No description provided for this field
0x298 SERDES0_LANE3_PRBS_ERR_CYC_FIRST_49_48 — No description provided for this register
  [31:0] value — No description provided for this field
0x2A0 SERDES0_LANE3_PRBS_ERR_CYC_LAST_7_0 — No description provided for this register
  [31:0] value — No description provided for this field
0x2A4 SERDES0_LANE3_PRBS_ERR_CYC_LAST_15_8 — No description provided for this register
  [31:0] value — No description provided for this field
0x2A8 SERDES0_LANE3_PRBS_ERR_CYC_LAST_23_16 — No description provided for this register
  [31:0] value — No description provided for this field
0x2AC SERDES0_LANE3_PRBS_ERR_CYC_LAST_31_24 — No description provided for this register
  [31:0] value — No description provided for this field
0x2B0 SERDES0_LANE3_PRBS_ERR_CYC_LAST_39_32 — No description provided for this register
  [31:0] value — No description provided for this field
0x2B4 SERDES0_LANE3_PRBS_ERR_CYC_LAST_47_40 — No description provided for this register
  [31:0] value — No description provided for this field
0x2B8 SERDES0_LANE3_PRBS_ERR_CYC_LAST_49_48 — No description provided for this register
  [31:0] value — No description provided for this field
