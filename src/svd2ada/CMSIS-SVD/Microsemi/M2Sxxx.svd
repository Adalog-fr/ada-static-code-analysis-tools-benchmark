# M2Sxxx register map
Vendor: Microsemi; Series: SmartFusion2; File version: 2.0.32
Microcontroller Subsystem (MSS) - Hard 166 MHz 32-Bit ARM Cortex-M3 Processor (r2p1) Embedded Trace Macrocell (ETM) Memory Protection Unit (MPU) JTAG Debug (4 wires), SW Debug (SWD, 2wires), SW Viewer (SWV) - 64 KB Embedded SRAM (eSRAM) - Up to 512 KB Embedded Nonvolatile Memory (eNVM) - Triple Speed Ethernet (TSE) 10/100/1000 Mbps MAC - USB 2.0 High Speed On-The-Go (OTG) Controller with ULPI Interface - CAN Controller, 2.0B Compliant, Conforms to ISO11898-1 - 2 Each: SPI, I2C, Multi-Mode UARTs (MMUART) Peripherals - Hardware Based Watchdog Timer - 1 General Purpose 64-Bit (or two 32-bit) Timer(s) - Real-Time Calendar/Counter (RTC) - DDR Bridge (4 Port Data R/W Buffering Bridge to DDR Memory) with 64-Bit AXI IF - 2 AHB/APB Interfaces to FPGA Fabric (master/slave capable) - 2 DMA Controllers to Offload Data Transactions from the Cortex-M3 Processor - 8-Channel Peripheral DMA (PDMA) - High Performance DMA (HPDMA) Clocking Resources - Clock Sources Up to 2 High Precision 32 KHz to 20 MHz Main Crystal Oscillator 1 MHz Embedded RC Oscillator 50 MHz Embedded RC Oscillator - Up to 8 Clock Conditioning Circuits (CCCs) Output Clock with 8 Output Phases Frequency: Input 1 to 200 MHz, Output 20 to 400MHz High Speed Serial Interfaces - Up to 16 SERDES Lanes, Each Supporting: XGXS/XAUI Extension (to implement a 10 Gbps (XGMII) Ethernet PHY interface) Native SERDES Interface Facilitates Implementation of Serial RapidIO PCI Express (PCIe) Endpoint Controller High Speed Memory Interfaces - U
CPU: CM3 r2p1, little endian, MPU, no FPU, 4 interrupt priority bits
Registers are 32-bit, read-write, no defined reset value unless marked. A register's access mark holds for its fields unless they carry their own. Offsets are from the block's base; lines under a group give offsets from that group; [hi:lo] are bit positions; {n}, {i} and the like mark numbered series; 'fields as' and 'values as' point back to an identical list; <NAME> marks a mode.

## Memory map
0x20029400 SERDES_0_LANE_1 size 0x2BC — No description provided for this peripheral
0x40000000 MMUART_0 size 0x54 — Multi-mode universal asynchronous/synchronous receiver/transmitter peripheral
0x40001000 SPI_0 size 0x50 — No description provided for this peripheral
0x40002000 I2C0 size 0x20 — No description provided for this peripheral
0x40003000 PDMA size 0x120 — No description provided for this peripheral
0x40004000 Timer size 0x58 — No description provided for this peripheral
0x40005000 Watchdog size 0x20 — No description provided for this peripheral
0x40010000 MMUART_1 size 0x54 — Multi-mode universal asynchronous/synchronous receiver/transmitter peripheral
0x40011000 SPI_1 size 0x50 — No description provided for this peripheral
0x40012000 I2C1 size 0x20 — No description provided for this peripheral
0x40013000 GPIO size 0x8C — General-purpose IO peripheral
0x40014000 HPDMA size 0x5C — No description provided for this peripheral
0x40015000 CAN size 0x620 — No description provided for this peripheral
0x40016000 COMBLK size 0x20 — No description provided for this peripheral
0x40017000 RTC size 0x70 — No description provided for this peripheral
0x40020800 MDDR size 0x44C — No description provided for this peripheral
0x40021000 FDDR size 0x54C — No description provided for this peripheral
0x40028000 SERDES_0_PCIE size 0x318 — No description provided for this peripheral
0x40029000 SERDES_0_LANE_0 size 0x2BC — No description provided for this peripheral
0x40029800 SERDES_0_LANE_2 size 0x2BC — No description provided for this peripheral
0x40029C00 SERDES_0_LANE_3 size 0x2BC — No description provided for this peripheral
0x4002A000 SERDES_0_SYS_REG size 0xB4 — No description provided for this peripheral
0x4002C000 SERDES_1_PCIE size 0x318 — No description provided for this peripheral
0x4002D000 SERDES_1_LANE_0 size 0x2BC — No description provided for this peripheral
0x4002D400 SERDES_1_LANE_1 size 0x2BC — No description provided for this peripheral
0x4002D800 SERDES_1_LANE_2 size 0x2BC — No description provided for this peripheral
0x4002DC00 SERDES_1_LANE_3 size 0x2BC — No description provided for this peripheral
0x4002E000 SERDES_1_SYS_REG size 0xB4 — No description provided for this peripheral
0x40038000 System_Registers size 0x2B4 — No description provided for this peripheral
0x40041000 Ethernet_MAC size 0x200 — No description provided for this peripheral
0x40043000 USB size 0x36C — No description provided for this peripheral
0x60080000 AHB_to_eNVM_0 size 0x200 — No description provided for this peripheral
0x600C0000 AHB_to_eNVM_1 size 0x200 — No description provided for this peripheral

## Interrupts
0 WDOGWAKEUPINT (Watchdog)
1 RTC_WAKEUP_INTR (RTC)
2 SPIINT0 (SPI_0)
3 SPIINT1 (SPI_1)
4 I2C_INT0 (I2C0)
5 I2C_SMBALERT0 (I2C0)
6 I2C_SMBSUS0 (I2C0)
7 I2C_INT1 (I2C1)
8 I2C_SMBALERT1 (I2C1)
9 I2C_SMBSUS1 (I2C1)
10 MMUART0_INTR (MMUART_0)
11 MMUART1_INTR (MMUART_1)
12 MAC_INT (Ethernet_MAC)
13 PDMAINTERRUPT (PDMA)
14 TIMER1_INTR (Timer)
15 TIMER2_INTR (Timer)
16 CAN_INTR (CAN)
17 ENVM_INT0 (AHB_to_eNVM_0)
18 ENVM_INT1 (AHB_to_eNVM_1)
19 COMM_BLK_INTR (COMBLK)
20 USB_MC_INT (USB)
21 USB_DMA_INT (USB)
22 MSSDDR_PLL_LOCK_INT (System_Registers)
23 MSSDDR_PLL_LOCKLOST_INT (System_Registers)
24 SW_ERRORINTERRUPT (System_Registers)
25 CACHE_ERRINTR (System_Registers)
26 DDRB_INTR (System_Registers)
27 HPD_XFR_CMP_INT (HPDMA)
28 HPD_XFR_ERR_INT (HPDMA)
29 ECCINTR (System_Registers)
30 MDDR_IO_CALIB_INT (System_Registers)
31 FAB_PLL_LOCK_INT (System_Registers)
32 FAB_PLL_LOCKLOST_INT (System_Registers)
33 FIC64_INT (System_Registers)
{n+50} GPIO_INT_{n} (GPIO) (n=0..31)

## Notices in the file
(c) Copyright 2009-2015 Microsemi  SoC Products Group.  All rights reserved.
